/ {
	amba_pl: amba_pl {
		ranges;
		compatible = "simple-bus";
		#address-cells = <1>;
		#size-cells = <1>;
		Simple_MMap_0: Simple_MMap@43c00000 {
			compatible = "xlnx,Simple-MMap-1.0";
			xlnx,irq-sensitivity = <1>;
			xlnx,s00-axi-data-width = <32>;
			xlnx,rable = <0>;
			xlnx,ip-name = "Simple_MMap";
			xlnx,s-axi-intr-data-width = <32>;
			reg = <0x43c00000 0x10000 0x43c10000 0x10000>;
			clocks = <&clkc 15>, <&clkc 15>;
			xlnx,irq-active-state = <1>;
			xlnx,edk-iptype = "PERIPHERAL";
			xlnx,intr-active-state = <0xFFFFFFFF>;
			xlnx,num-of-intr = <1>;
			xlnx,intr-sensitivity = <0xFFFFFFFF>;
			status = "okay";
			clock-names = "s00_axi_aclk" , "s_axi_intr_aclk";
			xlnx,s00-axi-addr-width = <6>;
			xlnx,s-axi-intr-addr-width = <5>;
			xlnx,name = "Simple_MMap_0";
		};
	};
};
